## native/boards/openwalkietalkie/hcpu/Kconfig.board
```kconfig
config BSP_USING_BOARD_OPENWALKIETALKIE
    bool
    select SOC_SF32LB52X
    select BF0_HCPU
    default y
config ASIC
    bool
    default y
```

## native/boards/openwalkietalkie/lcpu/Kconfig.board
```kconfig
config BSP_USING_BOARD_OPENWALKIETALKIE
    bool
    select SOC_SF32LB52X
    select BF0_LCPU
    default y
config ASIC
    bool
    default y
```
